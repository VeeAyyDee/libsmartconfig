## examples/provision/main/Kconfig.projbuild
```kconfig
# SPDX-License-Identifier: 0BSD
menu "Clean-room provisioning example"

choice SC_EXAMPLE_PROTOCOL
    prompt "Provisioning protocol"
    default SC_EXAMPLE_PROTOCOL_V2

config SC_EXAMPLE_PROTOCOL_V2
    bool "ESP-Touch v2"

config SC_EXAMPLE_PROTOCOL_V1
    bool "ESP-Touch v1"

config SC_EXAMPLE_PROTOCOL_AIRKISS
    bool "AirKiss full-message mode"

endchoice

config SC_EXAMPLE_V2_KEY
    string "ESP-Touch v2 AES key (32 hex digits, empty for plaintext)"
    depends on SC_EXAMPLE_PROTOCOL_V2
    default ""
    help
        A nonempty value must contain exactly 32 hexadecimal digits.
        This demonstration embeds the key in sdkconfig and firmware.
        It is not secure key storage. Never use this setting for production
        secrets without a separate key-management design.

config SC_EXAMPLE_AIRKISS_KEY
    string "AirKiss AES key (32 hex digits, empty for plaintext)"
    depends on SC_EXAMPLE_PROTOCOL_AIRKISS
    default ""
    help
        Explicitly selects encrypted-password AirKiss. This UI passes 16 raw
        key bytes; a shorter sender key must be zero-padded in this setting.
        The padded key is also the CBC IV. There is no on-wire mode flag or
        fallback to plaintext. The key is embedded in sdkconfig and firmware;
        this demonstration setting is not secure key storage.

endmenu
```

## examples/provision/sdkconfig.defaults
```kconfig
# SPDX-License-Identifier: 0BSD
CONFIG_ESP_PHY_CALIBRATION_AND_DATA_STORAGE=y
CONFIG_ESP_WIFI_NVS_ENABLED=y
CONFIG_ESP_MAIN_TASK_STACK_SIZE=6144
```

## examples/standard/main/Kconfig.projbuild
```kconfig
# SPDX-License-Identifier: 0BSD
menu "libsmartconfig standard API example"
config LIBSMARTCONFIG_EXAMPLE_TYPE
    int "Protocol: 0 ESPTouch, 1 AirKiss, 2 combined, 3 ESPTouch v2"
    range 0 3
    default 2
config LIBSMARTCONFIG_EXAMPLE_V2_KEY
    string "ESP-Touch v2 raw key encoded as 32 hex digits (empty for plaintext)"
    default ""
    help
        This demo embeds the key in sdkconfig and firmware. Not secure storage.
        Public SmartConfig has no encrypted-AirKiss key option; see the optional
        keyed AirKiss adapter example for that distinct extension.
endmenu
```

## examples/standard/sdkconfig.defaults
```kconfig
CONFIG_ESPTOOLPY_FLASHSIZE_16MB=y
CONFIG_ESP_PHY_CALIBRATION_AND_DATA_STORAGE=y
CONFIG_ESP_WIFI_NVS_ENABLED=y
```
